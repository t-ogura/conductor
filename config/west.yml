## config/west.yml
```yaml
manifest:
  defaults:
    revision: main
  remotes:
    - name: cormoran
      url-base: https://github.com/cormoran
    - name: pite1222
      url-base: https://github.com/pite1222
    - name: caksoylar
      url-base: https://github.com/caksoylar
  projects:
    - name: zmk
      remote: cormoran
      revision: v0.3-branch+dya
      import: app/west.yml
    # DYA Studio modules
    - name: zmk-module-ble-management
      remote: cormoran
    - name: zmk-module-battery-history
      remote: cormoran
    - name: zmk-module-settings-rpc
      remote: cormoran
    - name: zmk-module-runtime-input-processor
      remote: cormoran
    # Existing modules
    - name: zmk-pmw3610-driver
      remote: pite1222
    - name: zmk-rgbled-widget
      remote: caksoylar
  self:
    path: config
```
